## examples/esp32/fs-c3/sdkconfig.defaults
```kconfig
CONFIG_PARTITION_TABLE_CUSTOM=y
CONFIG_PARTITION_TABLE_CUSTOM_FILENAME="partitions.csv"
CONFIG_ESPTOOLPY_FLASHSIZE_2MB=y
CONFIG_WL_SECTOR_SIZE_4096=y
```
